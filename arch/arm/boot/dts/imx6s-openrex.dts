/*
 * Copyright (C) 2013 Freescale Semiconductor, Inc.
 *
 * This program is free software; you can redistribute it and/or modify
 * it under the terms of the GNU General Public License version 2 as
 * published by the Free Software Foundation.
 */

/dts-v1/;

#include "imx6dl.dtsi"
#include "imx6qdl-openrex.dtsi"

/ {
	model = "FEDEVEL i.MX6 SOLO OpenRex";
	compatible = "fsl,imx6s-openrex", "fsl,imx6dl";
	memory {
		reg = <0x10000000 0x20000000>;
	};
};


&mxcfb1 {
	status = "okay";
};

&mxcfb2 {
	status = "okay";
};

